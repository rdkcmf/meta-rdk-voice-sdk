## conf/layer.conf
```bitbake
BBPATH .= ":${LAYERDIR}"

BBFILES += "\
            ${LAYERDIR}/recipes-*/*/*.bb \
            ${LAYERDIR}/recipes-*/*/*.bbappend \
           "

BBFILE_COLLECTIONS += "rdk-voice-sdk"
BBFILE_PATTERN_rdk-voice-sdk := "^${LAYERDIR}/"
BBFILE_PRIORITY_rdk-voice-sdk = "8"

LAYERDEPENDS_rdk-voice-sdk = "rdk"

LICENSE_PATH += "${LAYERDIR}/"
LAYERSERIES_COMPAT_rdk-voice-sdk = "zeus dunfell"
```
